 /dts-v1/;  
 /plugin/;  
 
 / {  

   compatible = "ti,beaglebone", "ti,beaglebone-green", "ti,beaglebone-black";  
   part-number = "PRU-GPIO-EXAMPLE";  
   version = "00A0";
     

   fragment@0 {  
    target = <&am33xx_pinmux>;  
    __overlay__ {  
      example_pins: pinmux_pru_pru_pins {  

       pinctrl-single,pins = <  
		0x030 0x06  /* P8_12 out */
		0x034 0x06  /* P8_11 out */
		0x190 0x05  /* P9_31 out */
		0x194 0x05  /* P9_29 out */
		0x198 0x05  /* P9_30 out */
		0x19C 0x05  /* P9_28 out */
		0x1A0 0x05  /* P9_42 out */
		0x1A4 0x05  /* P9_27 out */
		0x1A8 0x05  /* P9_41 out */
		0x1AC 0x05  /* P9_25 out */
		0x1B4 0x20  /* CLKOUT2 to input as per datasheet (to enable P9_41) */
		0x164 0x20  /* GPIO0_7 to input as per datasheet (to enable P9_42) */
		0x03C 0x26  /* P8_15 in */
		0x038 0x26  /* P8_16 in */	 
       >;  
      };  
    };  
   };  
   
   fragment@1 {  
    target = <&pruss>;  
    __overlay__ {  
      status = "okay";  
      pinctrl-names = "default";  
      pinctrl-0 = <&example_pins>;  
    };  
   };  
 };  
